#include <behaviors.dtsi>
#include <dt-bindings/zmk/keys.h>
#include <dt-bindings/zmk/bt.h>

// Assigning layer name to layer number to use in keymap below
#define BASE 0
#define RAISELEFT 1
#define RAISERIGHT 2
#define FUNCTION 3
#define BLUETOOTH 4

/ {

    behaviors {

        TDP: tap_dance_tdp {
            compatible = "zmk,behavior-tap-dance";
            #binding-cells = <0>;
            tapping-term-ms = <200>;
            bindings = <&kp EQUAL>, <&kp PLUS>;
        };

        TDQ: tap_dance_tdq {
            compatible = "zmk,behavior-tap-dance";
            #binding-cells = <0>;
            tapping-term-ms = <200>;
            bindings = <&kp APOS>, <&kp DQT>;
        };
        };

    combos {
        compatible = "zmk,combos";
        combo_bt {
            timeout-ms = <50>;
            key-positions = <62 63>;
            bindings = <&mo 4>;
        };
    };

};

    keymap {
        compatible = "zmk,keymap";
          
        BASE {
            display-name = "Base";
            bindings = <
            
        // Keyboard layout - Base layer      
        //          Col 0        |      Col 1           |   Col 2    |      Col 3   |   Col 4     |     Col 5        |      Col 6           |        Col 7           |   Col 8            |   Col 9         |   Col 10  |   Col 11        | Col 12     |
        //  --------------------------------------------------------------------------------------------------------------------------------------------------------------------------------------------------------------------------------------------
                    &kp ESC             &kp N1          &kp N2      &kp N3          &kp N4              &kp N5              &kp N6                  &kp N7              &kp N8              &kp N9             &kp N0      &kp MINUS        &kp BSPC
                    &kp TAB             &kp Q           &kp W       &kp E           &kp R               &kp T                                       &kp Y               &kp U               &kp I              &kp O       &kp P            &kp BSLH
                    &kp CAPSLOCK        &kp A           &kp S       &kp D           &kp F               &kp G                                       &kp H               &kp J               &kp K              &kp L       &kp SEMI         &kp RETURN
                    &kp LEFT_SHIFT      &kp Z           &kp X       &kp C           &kp V               &kp B                                       &kp N               &kp M               &kp COMMA          &kp DOT     &kp SLASH        &kp RSHIFT
                                        &kp LCTRL       &kp LALT    &kp LGUI        &kp SPACE           &mo RAISERIGHT                              &mo RAISELEFT       &kp SPACE           &kp RGUI           &kp RALT    &mo FUNCTION
        >;
        
        };

        RAISELEFT {
            display-name = "Raise L";
            bindings = <

            // Raise left
            //      Col 0 |     Col 1        |    Col 2         |      Col 3       |       Col 4      |    Col 5    |  Col 6     | Col 7    |  Col 8     |   Col 9   |   Col 10  |   Col 11   |  Col 12   | 
            //      ---------------------------------------------------------------------------------------------------------------------------------------------------------------------------------------
                    &kp TILDE   &kp C_BRI_DN      &kp C_BRI_UP    
                                &kp HOME          &kp UP               &kp END
                                &kp LEFT          &kp DOWN             &kp RIGHT
                                                  &kp PG_DN            &kp PG_UP
            
            >;

        };

        RAISERIGHT {
            display-name = "Raise R";
            bindings = <

        // Raise right
        //      Col 0 |  Col 1   |   Col 2    |  Col 3    |  Col 4    |  Col 5    |  Col 6     |    Col 7       |     Col 8         |   Col 9            |  Col 10  |        Col 11   |             Col 12   |      Col 13   |  Col 14   |
            //      -----------------------------------------------------------------------------------------------------------------------------------------------------------------------------------------------------------------------
                                                                                                                                                                                                                    
                                                                                                                                                               
                                                                                                    &kp C_PREVIOUS      &kp C_PLAY_PAUSE    &kp C_NEXT      &TDQ
                                                                                                    &kp C_MUTE          &kp C_VOL_DN        &kp C_VOL_UP                                 
                                                                                                                                                                                                                   
            >;

        };

        FUNCTION {
            display-name = "Function";
            bindings =<
        //
        // Function keys & Bluetooth settings
        //
        //      Col 0 |   Col 1   |     Col 2       |   Col 3    |  Col 4      |    Col 5     |     Col 6    |  Col 7 |    Col 8  |    Col 9   |   Col 10  |   Col 11   |  Col 12   |  Col 13   |  Col 14  |
        //      --------------------------------------------------------------------------------------------------------------------------------------------------------------------------------------------
                          &kp F1        &kp F2          &kp F3      &kp F4          &kp F5          &kp F6      &kp F7     &kp F8      &kp F9      &kp F10         
        >;

        };

        BLUETOOTH {
            display-name = "Bluetooth";
            bindings =<
        //
        // Reset keys & Bluetooth settings
        //
        //      Col 0 |   Col 1   | Col 2           |   Col 3            |  Col 4      |    Col 5     |     Col 6        |  Col 7 |    Col 8  |    Col 9   |   Col 10  |   Col 11   |  Col 12   |  Col 13   |  Col 14  |
        //      --------------------------------------------------------------------------------------------------------------------------------------------------------------------------------------------------------
                                    &bt BT_SEL 0        &bt BT_SEL 1        &bt BT_SEL 2
                                    &bt BT_CLR          &bt BT_CLR_ALL

                                                                                            &sys_reset      &bootloader

        >;

    };
};