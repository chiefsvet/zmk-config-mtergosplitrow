## config/boards/shields/mtergosplitrow/kconfig.defconfig
```kconfig
if SHIELD_MTERGOSPLITROW_LEFT

config ZMK_KEYBOARD_NAME
    default "mtergosplitrow"

config ZMK_SPLIT_ROLE_CENTRAL
    default y

endif

if SHIELD_MTERGOSPLITROW_LEFT || SHIELD_MTERGOSPLITROW_RIGHT

config ZMK_SPLIT
    default y

endif
```

## config/boards/shields/mtergosplitrow/kconfig.shield
```kconfig
config SHIELD_MTERGOSPLITROW_LEFT
    def_bool $(shields_list_contains,mtergosplitrow_left)

config SHIELD_MTERGOSPLITROW_RIGHT
    def_bool $(shields_list_contains,mtergosplitrow_right)
```
